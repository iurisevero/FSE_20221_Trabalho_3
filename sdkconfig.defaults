## sdkconfig.defaults
```kconfig
CONFIG_ESP_WIFI_SSID="ssid"
CONFIG_ESP_WIFI_PASSWORD="minha_senha"
CONFIG_ESP_MAXIMUM_RETRY=5
CONFIG_MQTT_URI="mqtt://"
CONFIG_MQTT_USERNAME="chavedeacesso"
CONFIG_BATTERY_MODE=n

CONFIG_ESPTOOLPY_FLASHSIZE_4MB=y
CONFIG_ESPTOOLPY_FLASHSIZE="4MB"

CONFIG_PARTITION_TABLE_CUSTOM=y
CONFIG_PARTITION_TABLE_CUSTOM_FILENAME="partitions.csv"
CONFIG_PARTITION_TABLE_FILENAME="partitions.csv"
```

## src/Kconfig.projbuild
```kconfig
menu "MQTT Configuration"
    config MQTT_URI
        string "Uri para conexão do MQTT"
        default "mqtt://"
        help
            Uri para conexão do MQTT (sem a porta).
    config MQTT_USERNAME
        string "Username de acesso ao dispositivo"
        default "chavedeacesso"
        help
            Chave de acesso ao dispositivo, pode ser gerada no ThinksBoard.
endmenu

menu "Energy/Battery Mode Configuration"
    config BATTERY_MODE
        bool "Boleano para definir modo de bateria"
        default n
        help
            Define o dispositivo para modo de bateria, caso contrário estará no modo de energia.
endmenu
```
